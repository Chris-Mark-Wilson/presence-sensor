## sdkconfig.defaults
```kconfig
# Zigbee
CONFIG_ZB_ENABLED=y
CONFIG_ZB_ZCZR=y
CONFIG_ZB_RADIO_NATIVE=y
CONFIG_PARTITION_TABLE_CUSTOM=y
CONFIG_PARTITION_TABLE_CUSTOM_FILENAME="partitions.csv"

# Log level
CONFIG_LOG_DEFAULT_LEVEL_INFO=y
```
